/*
 ^ SPDX-License-Identifier: GPL-2.0-only
 *
 * Description taken from the following pointer:
 * sc16is7xx uart i2c kernelmodule problems #2241
 * https://github.com/raspberrypi/linux/issues/2241
 *
 * Example taken (and adapted for NXP sc16is740 silicon) from the following pointer:
 * https://github.com/Ysurac/raspberry_kernel_mptcp/blob/master/arch/arm/boot/dts/overlays/sc16is750-i2c-overlay.dts
 */

/dts-v1/;
/plugin/;

/ {
	compatible = "ti,beaglebone", "ti,beaglebone-black";

	fragment@0 {
		target = <&i2c_arm>;
		__overlay__ {
			#address-cells = <1>;
			#size-cells = <0>;
			status = "okay";

			sc16is740: sc16is740@48 {
				compatible = "nxp,sc16is740";
				reg = <0x48>; /* address */
				clocks = <&sc16is740_clk>;
				interrupt-parent = <&gpio>;
				interrupts = <24 2>; /* IRQ_TYPE_EDGE_FALLING */
				#gpio-cells = <2>;

				sc16is740_clk: sc16is740_clk {
					compatible = "fixed-clock";
					#clock-cells = <0>;
					clock-frequency = <14745600>;
				};
			};
		};
	};

	__overrides__ {
		int_pin = <&sc16is740>,"interrupts:0";
		addr = <&sc16is740>,"reg:0";
	};
};
